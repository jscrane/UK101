#include <Energia.h>

#include "Memory.h"
#include "ukkbd.h"

// maps scan codes to uk101 rows/cols + modifiers
static const unsigned short scanmap[128] = {
  0xffff, 0xffff, 0xffff, 0xffff, 0xffff, 0xffff, 0xffff, 0xffff,    // 0x00 
  0xffff, 0xffff, 0xffff, 0xffff, 0xffff, 0xffff, 0xffff, 0xffff,    // 0x08 
  0xffff, 0xffff, 0x0002, 0xffff, 0x0006, 0x0017, 0x0077, 0xffff,    // 0x10 
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  0xffff, 0xffff, 0xffff, 0xffff, 0xffff, 0xffff, 0xffff, 0xffff,    // 0x78 
};

static const unsigned short shiftmap[128] = {
  0xffff, 0xffff, 0xffff, 0xffff, 0xffff, 0xffff, 0xffff, 0xffff,    // 0x00 
  0xffff, 0xffff, 0xffff, 0xffff, 0xffff, 0xffff, 0xffff, 0xffff,    // 0x08 
  0xffff, 0xffff, 0xffff, 0xffff, 0xffff, 0xffff, 0x0277, 0xffff,    // 0x10 
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  0xffff, 0xffff, 0xffff, 0xffff, 0xffff, 0xffff, 0xffff, 0xffff,    // 0x78 
};

unsigned short ukkbd::_map(byte sc)
{
  // left- or right-shift
  if (sc == 0x12 || sc == 0x59) {
    _shifted = !_shifted;
    Serial.print("map ");
    Serial.println(_shifted);
    return scanmap[sc];
  } 
  if (_shifted) {
    unsigned short sh = shiftmap[sc];
    Serial.print("shift ");
    Serial.println(sh, HEX);
    if (sh == 0x0000)
      return 0xffff;
    if (sh != 0xffff)
      return sh;
  }
  return scanmap[sc];
}

void ukkbd::reset() {
  for (int i=8; i--; )
    _rows[i] = 0;
  // shift-lock on
  _rows[0] = 1;
}

void ukkbd::operator= (byte row) {
  _last = row;
}

byte ukkbd::pattern() {
  int r = 255-_last;
  byte pattern = 0;
  for (int i=8; i--; r>>=1) 
    if (r & 1)
      pattern |= _rows[7-i];

  return pattern ^ 0xff;
}

void ukkbd::_reset (byte k) {
  _rows[(k & 0xf0) >> 4] &= ~(1 << (k & 0x0f));
}

void ukkbd::up (byte scan) {
  Serial.print("up ");
  Serial.println(scan, HEX);
  unsigned short k = _map(scan);
  if (k != 0xffff) {
    if (!_shifted && k > 0xff) 
      _reset (k / 0xff);
    if (k > 0)
      _reset (k & 0xff);
  }
}

void ukkbd::_set (byte k) {
  _rows[(k & 0xf0) >> 4] |= 1 << (k & 0x0f);
}

void ukkbd::down (byte scan) {
  Serial.print("down ");
  Serial.println(scan, HEX);
  unsigned short k = _map(scan);
  if (k != 0xffff) {
    if (_shifted) {
      if (k < 0xff)
        _reset(0x02);
    } else if (k > 0xff)
      _set(k / 0xff);
    if (k > 0)
      _set(k & 0xff);
    else  // toggle caps lock
      _rows[0] ^= 1;
  }
}

